## sdkconfig.defaults
```kconfig
# ESP-IDF Project — ESP32 YS Video Player
#

CONFIG_IDF_TARGET="esp32"
CONFIG_IDF_TARGET_ESP32=y

# Serial flasher config
CONFIG_ESPTOOLPY_FLASHSIZE_16MB=y
CONFIG_ESPTOOLPY_FLASHFREQ_80M=y
CONFIG_ESPTOOLPY_FLASHMODE_QIO=y
CONFIG_ESPTOOLPY_BAUD_921600B=y

# ESP32 cpu config
CONFIG_ESP32_DEFAULT_CPU_FREQ_240=y
CONFIG_ESP32_ESP32_SPIRAM_SUPPORT=n

# Partition table — 4MB app, 12MB FATFS
CONFIG_PARTITION_TABLE_CUSTOM=y
CONFIG_PARTITION_TABLE_CUSTOM_FILENAME="partitions.csv"

# FATFS
CONFIG_FATFS_CODEPAGE=437=y
CONFIG_FATFS_LFN_STACK=y
CONFIG_FATFS_MAX_LFN=255=y

# SPIRAM disable (CYD doesn't have PSRAM)
CONFIG_ESP32_SPIRAM_SUPPORT=n

# Optimize for speed
CONFIG_ESPTOOLPY_FLASHSIZE_16MB=y

# Console
CONFIG_ESP_CONSOLE_UART_BAUDRATE=115200=y
CONFIG_ESP_CONSOLE_UART_DEFAULT=y

# No wifi to save memory
CONFIG_ESP_WIFI_ENABLED=n
CONFIG_ESP_HTTP_CLIENT_ENABLED=n

# Logging
CONFIG_LOG_DEFAULT_LEVEL_INFO=y
CONFIG_LOG_MAXIMUM_LEVEL_VERBOSE=n

# Memory
CONFIG_ESP_SYSTEM_EVENT_QUEUE_SIZE=16=y
CONFIG_ESP_SYSTEM_TASK_STACK_SIZE=4096=y
```
